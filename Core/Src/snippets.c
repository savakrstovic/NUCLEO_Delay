/*
 * snippets.c
 *
 *  Created on: 1 Jun 2026
 *      Author: savak
 *
 *      Here are just the snippets of code generated by Gemini AI that will be later used in project
 */


/*	Snippet for using the HR Timer to generate clock for BBD IC's	*/

/* USER CODE BEGIN Includes */
#include "main.h"
#include <stdint.h>
/* USER CODE END Includes */

/* USER CODE BEGIN PV */
// Define the mapping constants based on a 170MHz * 32 (5.44GHz) HRTIM clock
#define ADC_MIN 0
#define ADC_MAX 4095
#define HRTIM_TICKS_MIN 53125    // ~20ms delay (approx 100kHz BBD clock)
#define HRTIM_TICKS_MAX 1328125  // ~500ms delay (approx 4kHz BBD clock)

// Potentiometer reading variable
uint16_t time_pot_value = 0;
/* USER CODE END PV */

/* USER CODE BEGIN 0 */

/**
  * @brief  Updates the HRTIM Master Period and Compare registers safely using Preload
  */
void HRTIM_Update_Frequency(uint32_t targetPeriodTicks)
{
    // Ensure the period is an even number for a perfect 50% duty cycle split
    if (targetPeriodTicks % 2 != 0)
    {
        targetPeriodTicks++;
    }

    // 1. Write the new total cycle duration to the Master Period Shadow Register
    __HAL_HRTIM_MASTER_SET_PERIOD(&hhrtim1, targetPeriodTicks);

    // 2. Write the 50% mark to the Master Compare Shadow Register
    __HAL_HRTIM_MASTER_SET_COMPARE(&hhrtim1, HRTIM_COMPAREUNIT_1, (targetPeriodTicks / 2));
}

/**
  * @brief  Reads the ADC, applies a logarithmic audio taper, and sets the HRTIM
  */
void Update_Delay_From_Pot_Audio_Taper(uint16_t adc_value)
{
    // Constrain ADC value
    if(adc_value > ADC_MAX) adc_value = ADC_MAX;

    // Create a quadratic taper: square the ADC value, then divide by the max ADC value
    // This turns a linear pot sweep into a smooth, musical curve
    uint32_t tapered_adc = ((uint32_t)adc_value * (uint32_t)adc_value) / ADC_MAX;

    // Map the tapered value to the HRTIM ticks
    uint32_t target_ticks = HRTIM_TICKS_MIN +
                           ((uint64_t)(tapered_adc) * (HRTIM_TICKS_MAX - HRTIM_TICKS_MIN))
                           / ADC_MAX;

    // Push the new value to the timer
    HRTIM_Update_Frequency(target_ticks);
}

/* USER CODE END 0 */

/**
  * @brief  The application entry point.
  */
int main(void)
{
  /* MCU Configuration--------------------------------------------------------*/
  /* Reset of all peripherals, Initializes the Flash interface and the Systick. */
  HAL_Init();

  /* Configure the system clock */
  SystemClock_Config();

  /* Initialize all configured peripherals (Generated by CubeMX) */
  MX_GPIO_Init();
  MX_HRTIM1_Init();
  MX_ADC1_Init();

  /* USER CODE BEGIN 2 */

  // Start the HRTIM Master and Timer A (BBD Clock Output on TA1)
  HAL_HRTIM_WaveformOutputStart(&hhrtim1, HRTIM_OUTPUT_TA1);
  HAL_HRTIM_MasterCounterStart(&hhrtim1);
  HAL_HRTIM_WaveformCountStart(&hhrtim1, HRTIM_TIMERID_TIMER_A);

  // Calibrate and start the ADC for the potentiometer
  HAL_ADCEx_Calibration_Start(&hadc1, ADC_SINGLE_ENDED);
  HAL_ADC_Start(&hadc1);

  /* USER CODE END 2 */

  /* Infinite loop */
  /* USER CODE BEGIN WHILE */
  while (1)
  {
      // 1. Read the physical linear potentiometer
      if (HAL_ADC_PollForConversion(&hadc1, 10) == HAL_OK)
      {
          time_pot_value = HAL_ADC_GetValue(&hadc1);

          // 2. Translate the ADC reading to a tapered HRTIM frequency
          Update_Delay_From_Pot_Audio_Taper(time_pot_value);
      }

      // Add a tiny delay so we don't bombard the shadow registers millions of times a second
      HAL_Delay(5);

    /* USER CODE END WHILE */
  }
}


/* ==============================================================================
 *                         SNIPPET 2: WOW & FLUTTER LFO (TIM6 + CORDIC)
 * ============================================================================== */

// Note: These variables were used in the snippet to communicate with main.c
// extern uint16_t pot_mod_rate;   // How fast the tape flutters
// extern uint16_t pot_mod_depth;  // How violently the pitch bends
// extern uint32_t current_base_hrtim_period; // The main delay time set by the Time knob

// LFO Phase tracking
// uint32_t lfo_phase_accumulator = 0;

/**
  * @brief  This interrupt fires 1000 times a second (e.g., from TIM6)
  */
void HAL_TIM_PeriodElapsedCallback(TIM_HandleTypeDef *htim)
{
    if (htim->Instance == TIM6)
    {
        // 1. Calculate the phase step (Rate)
        // The higher the pot_mod_rate, the faster the accumulator overflows (faster LFO)
        uint32_t phase_step = 100 + (pot_mod_rate * 5); // Base speed + knob offset
        lfo_phase_accumulator += phase_step;

        // 2. Prepare the CORDIC (Hardware Sine Wave Calculation)
        // CORDIC input must be scaled to q1.31 format representing -pi to +pi
        int32_t cordic_input = (int32_t)lfo_phase_accumulator;
        int32_t cordic_output;

        // Command the CORDIC to calculate the Sine of the input phase
        HAL_CORDIC_Calculate(&hcordic, &cordic_input, &cordic_output, 1, 0);

        // cordic_output is now a value from -1.0 to +1.0 (in q1.31 integer format)
        // Convert it to a usable float between -1.0f and 1.0f for easy math
        float sine_wave = (float)cordic_output / 2147483648.0f;

        // 3. Scale the Sine wave by the Depth Knob
        // Map the 0-4095 ADC value to a maximum tick deviation
        // (e.g., +/- 2000 HRTIM ticks maximum pitch bend)
        float max_tick_deviation = (pot_mod_depth / 4095.0f) * 2000.0f;

        int32_t tick_modulation = (int32_t)(sine_wave * max_tick_deviation);

        // 4. Apply the modulation to the base delay time
        uint32_t modulated_hrtim_period = current_base_hrtim_period + tick_modulation;

        // 5. Push instantly to the HRTIM
        // (Re-using the safe update function we wrote earlier)
        HRTIM_Update_Frequency(modulated_hrtim_period);
    }
}

/* ============================================================================== *
 *                         SNIPPET 3: MICROSECOND DELAY (DWT)					  *
 * ============================================================================== */

// Initialization (Put in main before while(1)):
CoreDebug->DEMCR |= CoreDebug_DEMCR_TRCENA_Msk; // Enable Trace Debug
DWT->CYCCNT = 0;                                // Reset Counter
DWT->CTRL |= DWT_CTRL_CYCCNTENA_Msk;            // Enable Counter

// Function Definition:
void Delay_us(uint32_t us)
{
    // Record the current CPU cycle count
    uint32_t startTick = DWT->CYCCNT;
    
    // Calculate how many CPU cycles are in our requested delay
    uint32_t delayTicks = us * (SystemCoreClock / 1000000);
    
    // Wait until the elapsed cycles reach our target. 
    while ((DWT->CYCCNT - startTick) < delayTicks)
    {
        // Block and wait
    }
}
